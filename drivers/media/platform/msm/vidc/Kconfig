## drivers/media/platform/msm/vidc/Kconfig
```kconfig
#
# VIDEO CORE
#

menuconfig MSM_VIDC_V4L2
	tristate "Qualcomm MSM V4L2 based video driver"
	depends on ARCH_QCOM && VIDEO_V4L2
	depends on IOMMU_DMA
	select VIDEOBUF2_DMA_SG
	select QCOM_SCM
```
